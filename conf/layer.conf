## conf/layer.conf
```bitbake
# We have a conf and classes directory, add to BBPATH
BBPATH .= ":${LAYERDIR}"

# We have recipes-* directories, add to BBFILES
BBFILES += "${LAYERDIR}/recipes-*/*/*.bb \
            ${LAYERDIR}/recipes-*/*/*.bbappend"

BBFILE_COLLECTIONS += "meta-fermenting-box"
BBFILE_PATTERN_meta-fermenting-box = "^${LAYERDIR}/"
BBFILE_PRIORITY_meta-fermenting-box = "6"

LAYERDEPENDS_meta-fermenting-box = "core"
LAYERSERIES_COMPAT_meta-fermenting-box = "walnascar"
```
